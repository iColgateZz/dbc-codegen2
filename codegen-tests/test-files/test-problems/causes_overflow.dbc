BO_ 100 DRIVER_HEARTBEAT: 1 DRIVER
 SG_ temp : 0|8@1+ (1,-128) [-128|127] "" SENSOR,MOTOR
